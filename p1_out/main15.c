/*
* Програма 15. 4-ри світлодіоди підключено до порту B і 4-ри до порту  D.
*
* Призначення програми: Світлодіоди вмикаються послідовно по одному, 
*                       по два, і т.д з повтореннями.
* 
* 4-м світлодіодів приєднані до порту B, піни 0-3.
* 4-м світлодіодів приєднані до порту D, піни 0-3.
* 
* Послідовність підключення світлодіодів в ряду:
* PB0 PB1 PB2 PB3 PD0 PD1 PD2 PD3
* 0   1   2   3   4   5   6   7
*
*/

#include <avr/io.h>
#include <util/delay.h>

int main15(void)
{
	int delay = 500;
	
	PORTB = 0x00;
	PORTD = 0x00;
	DDRB = (1<<PB0)|(1<<PB1)|(1<<PB2)|(1<<PB3);
	DDRD = (1<<PD0)|(1<<PD1)|(1<<PD2)|(1<<PD3);
	uint8_t led = 0x00;	
	uint8_t musk_b = 0b00001111;
	uint8_t musk_d = 0b00001111;
	
	while (1)
	{
		for(int i = 0; i < 8; i++)
		{
			for(int j = 0; j < (8-i); j++)
			{
				led = 0x00;
				for(int k = j; k < (j+i+1); k++)
				{
					led |= (1<<k);
				}
				PORTB = (musk_b & led);      /* Запис в піни, які не використовуються напряму, 
				                                може порушити роботу контролеру, якщо ці піни 
												використовуються в іншій частині програми.
											    Дана код є неправильним. */
				PORTD = (musk_d & (led>>4)); /* Запис в піни, які не використовуються напряму, 
				                                може порушити роботу контролеру, якщо ці піни 
												використовуються в іншій частині програми.
											    Дана код є неправильним. */
				_delay_ms(delay);
			}
		}
	}
}

