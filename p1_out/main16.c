/*
* Програма 16. Світлодіоди приєднані до інших пінів порту B (4-7) і D (4-7).
*
* Призначення програми: Світлодіоди вмикаються послідовно по одному,
*                       по два, і т.д з повтореннями.
*
* 4-м світлодіодів приєднані до порту B, піни 4-7.
* 4-м світлодіодів приєднані до порту D, піни 4-7.
*
* Послідовність підключення світлодіодів в ряду:
* PB4 PB5 PB6 PB7 PD4 PD5 PD6 PD7
* 0   1   2   3   4   5   6   7
*
*/

#include <avr/io.h>
#include <util/delay.h>

int main16(void)
{
	int delay = 500;
	
	PORTB = 0x00;
	PORTD = 0x00;
	DDRB = (1<<PB4)|(1<<PB5)|(1<<PB6)|(1<<PB7);
	DDRD = (1<<PD4)|(1<<PD5)|(1<<PD6)|(1<<PD7);
	uint8_t led = 0x00;
	uint8_t musk_b = 0b11110000;
	uint8_t musk_d = 0b11110000;
	
	while (1)
	{
		for(int i = 0; i < 8; i++)
		{
			for(int j = 0; j < (8-i); j++)
			{
				led = 0x00;
				for(int k = j; k < (j+i+1); k++)
				{
					led |= (1<<k);
				}
				PORTB = (musk_b & (led<<4)); /* Запис в піни, які не використовуються напряму, 
				                                може порушити роботу контролеру, якщо ці піни 
												використовуються в іншій частині програми.
											    Дана код є неправильним. */
				PORTD = (musk_d & led);      /* Запис в піни, які не використовуються напряму, 
				                                може порушити роботу контролеру, якщо ці піни 
												використовуються в іншій частині програми.
											    Дана код є неправильним. */
				_delay_ms(delay);
			}
		}
	}
}

