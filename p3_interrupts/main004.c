/* 
* Програма 4. Використання таймера/лічильника. Таймер 0.
* Нормальний режим. 
*
* Призначення програми: мигання світлодіоду LED0
* використовуючи таймер. 
* 
* LED0 світлодіод приєднаний до PB0 порту B.
*
* В даному проекті таймер використовується 
* для створення затримки.
* Таймер 0 - 8 бітний, - лічить від 0 до 255.
* Поточне значення лічильника зберігається в
* регістрі TCNT0. 
* В нормальному режимі лічильник збільшує 
* значення TCNT0. При досягненні максимального
* значення 255, в наступний відлік значення 
* TCNT0 обнуляється і в регістрі TIFR0 
* встановлюється TOV0 біт, як індикація того,
* що лічильник переповнився. 
*
* Розрахунок кількості повних циклів лічильника
* для створення потрібної затримки між миганнями LED0.
* 
* Затримка між переключенням               tdel.
* Тактова частота перефірійних модулів     fclk_io.
* Подільник частоти                        N.
* Тактова частота таймера                  f0 = fclk_io/N.
* Часова роздільна здатність таймера       t0 = 1/f0.
* Тривалість одного повного циклу таймера  t8 = t0*255.
* Кількість n повних циклів таймера 
* для досягнення затримки tdel:            n = tdel/t8.
*
* tdel    = 1с.
* fclk_io = 1МГц.
* N       = 1024.
* f0      = 1МГц/1024     = 976,5625Гц.
* t0      = 1/976,5625Гц  = 0,001024с.
* t8      = 0,001024с*255 = 0,26112с.
* n       = 1с/0,26112с   = 3,829657 = 4
*
* 
*/

#include <avr/io.h>
#define F_CPU 1000000UL                                /* Тактова частота процесора. */
#define LED0 PB0

int main004(void)
{
	int current_n = 0;
	const int n = 4;
	
	/* Налаштування виводів */     
	PORTB = 0x00;
	DDRB = (1<<LED0);              
	                           
    /* Налаштування тамеру 0*/
    TCNT0 = 0x00;                                      /* Очистка регістру поточного значення 
	                                                      лічильника. */
	TCCR0A = 0x00;                                     /* Нормальний режим роботи. */
	TCCR0B = (1<<CS02)|(1<<CS00);                      /* Вибір внутрішнього джерела тактових сигналів:
	                                                      fclk_io = F_CPU = 1МГц.
	                                                      Подільник частоти N = 1024. 
														  Запуск лічильника. */
 
    while (1) 
    {
        while((TIFR0 & (1<<TOV0)) == 0);               /* Відбулось переповнення лічильника? */
		TIFR0 = (1<<TOV0);                             /* Для очищення біту TOV0 в TIFR0 регістрі,
		                                                  потрібно встановити 1 в TOV0 біт. */
		current_n++;
		
		if(current_n == n)
		{
		    PINB = (1<<LED0);
		    current_n = 0;
		}
    }
	
    return 0;
}

