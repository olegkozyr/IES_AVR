/*
* Програма 2. Робота з чотирьох цифровим семисегментним дисплеєм.
*
* Призначення програми: вивід чотирьохзначного десяткового
* числа на дисплей. Всі цифри числа однакові, починаючи від
* 0000 до 9999.
*
* Обладнання:
* - мікроконтролер ATmega168
* - чотирьох цифровий семисегментний дисплей 7seg-mpx4-ca;
* 
* 7seg-mpx4-ca дисплей складається із чотирьом семисегментних
* індикаторів. Індикатори відносяться до типу із загальним анодом,
* тобто всі сегменти (світлодіоди) індикатору з'єднані своїми 
* анодами з джерелом живлення. Виводи мікроконтролеру приєднуються 
* до катодів світлодіодів. Щоб відобразити на індикаторі
* певну цифру повинна увімкнутись певна комбінація світлодіодів,
* а решта світлодіодів повинна бути вимкнена.
* Для того, щоб світлодіод індикатора із загальним анодом 
* увімкнувся на його катоді повинен бути потенціал нижчий за
* потенціал аноду. Тому, для увімкнення певного сегменту
* індикатора на відповідному виході мікроконтролеру повинен
* бути встановлений логічний нуль. Для вимкнення сегменту на 
* виході повинна бути логічна одиниця.
* 
* Робота з даним типом дисплея має свої особливості. В кожен
* момент часу можна виводити цифру тільки на один індикатор 
* дисплея. Тому, в кожен момент часу увімкнутий тільки один
* індикатор, а всі інші вимкнуті.
* Якщо послідовно вмикати кожен індикатор дисплея через досить
* малий проміжок часу, який менший за час реакція ока людини,
* то складається відчуття, що всі сегменти дисплею увімкнуті
* одночасно.
* В симуляторі PROTEUS для дисплею 7seg-mpx4-ca цей час < 10 мс.
*
* Дисплей 7seg-mpx4-ca містить два набори виводів:
* - перший містить вісім виводів, позначені "ABCDEFG DP";
* - другий містить чотири виводи, позначені "1234".
* Перший набір виводів керує сегментами конкретного індикатору.
* "ABCDEFG" виводи керують сегментами (світлодіодами) 
* індикатору для відображення цифри. 
* "DP" вивід керує світлодіодом, який відображає десяткову точку
* в правому нижньому куті індикатору. 
* Другий набір виводів слугує вибору конкретного індикатора
* дисплея.
*
* Виводи порту D приєднані до виводів "ABCDEFG DP" дисплею: 
* PD0-"A", PD1-"B", ..., PD6-"G", PD7-"DP".
* Виводи PB0-PB3 приєднані до виводів "1234": 
* PB0-"1", PB1-"2", PB2-"3", PB3-"4".
*
*/

#include <avr/io.h>
#define F_CPU            1000000UL                     /* Тактова частота процесору. */
#include <util/delay.h>

#define DIGIT_1          (1<<PB0)                      /* Активується 1-й індикатор. */
#define DIGIT_2          (1<<PB1)                      /* Активується 2-й індикатор. */
#define DIGIT_3          (1<<PB2)                      /* Активується 3-й індикатор. */
#define DIGIT_4          (1<<PB3)                      /* Активується 4-й індикатор. */

#define DIGIT_COUNT      10                            /* Кількість цифр від 0 до 9. */

#define DELAY_DIGIT      10                            /* мс, час затримки між перемиканням на інший
	                                                      індикатор. */
#define DELAY_DISPLAY    20                            /* Кількість циклів повтору виведених цифр. */

/* Масив комбінацій значень виводів порту D для відображення цифр від 0 до 9.
   Індекс масиву відповідає цифрі, яку потрібно вивести на індикатор. */
static const uint8_t number_code[] = {0xc0,0xf9,0xa4,0xb0,0x99,0x92,0x82,0xf8,0x80,0x90};

int main02(void)
{
	/* Ініціалізація вихідних 12 виводів. */
	PORTB = 0x00;
	PORTD = 0x00;
	DDRB = 0x0F;                                       /* Виводи для вибору індикатору. */
	DDRD = 0xFF;                                       /* Виводи для виводу цифр на індикатор. */
	
	/* Лічильники циклів. */
	uint8_t i = 0;
	uint8_t j = 0;
	
	while (1)
	{
		for(j = 0; j < DIGIT_COUNT; j++)               /* Цикл виводу цифр від 0 до 9. */
		{	
			for(i = 0; i < DELAY_DISPLAY; i++)         /* Цикл повтору виведених цифр. */
			{
				PORTB = DIGIT_1;                       /* Активація 1-го індикатору. */
				PORTD = number_code[j];                /* Вивід числа на 1-й індикатор. */
				_delay_ms(DELAY_DIGIT);                /* Затримка перемикання на 2-й індикатор*/
				PORTB = DIGIT_2;
				PORTD = number_code[j];
				_delay_ms(DELAY_DIGIT);
				PORTB = DIGIT_3;
				PORTD = number_code[j];
				_delay_ms(DELAY_DIGIT);
				PORTB = DIGIT_4;
				PORTD = number_code[j];
				_delay_ms(DELAY_DIGIT);
			}
		}
	}
}

